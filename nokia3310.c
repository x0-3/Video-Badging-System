
/****************************************************
*            Afficheur Nokia 3310                   *
****************************************************/


/*------------------------------------------------------------------------------------
                                    Définition de type
--------------------------------------------------------------------------------------*/
typedef enum
{
    Lcd_Cmd  = 0,
    Lcd_Data = 1
} LcdCmdData; // Type de transfert : commande ou données

typedef enum
{
    Blanc = 0,
    Noir  = 10
} Couleur; // Type de couleur

/*------------------------------------------------------------------------------------
                                         Constantes
--------------------------------------------------------------------------------------*/

/*------------------
       Liaisons
--------------------*/

#define Lcd_DIN_Pin PIN_C2  //  RB4 = SDIN
#define Lcd_CLK_Pin PIN_C5  //  RB3 = SCLK
#define Lcd_CE_Pin  PIN_B1  //  RC2 = CE_LCD
#define Lcd_DC_Pin  PIN_C1  //  RB5 = D/C
#define Lcd_RST_Pin PIN_C0  //  RB2 = RESET_LCD

/*-------------------------
  Constantes LCD Nokia 3310
---------------------------*/
#define Lcd_X_res       84
#define Lcd_Y_res       48
// Commandes controleur PCD8544
#define Function_Set    0x20    //Bit 2 = PD, Bit 1 = V, Bit 1 = H
#define Lcd_ON_Norm_H   0x20    //Lcd actif, adressage H, mode normal
#define Lcd_ON_Norm_V   0x22    //Lcd actif, adressage V, mode normal
#define Lcd_ON_Etendu_H 0x21    //Lcd actif, adressage H, mode étendu (H=1)
#define Lcd_OFF_Norm_H  0x24    //Lcd "power down", adressage H, mode normal
// Commandes normales (bit H="0")
#define Set_Config      0x08    //Bit 2 = D, bit 0 = E
#define Set_Adr_Y       0x40    //Adresse Y dans 3 bits LSB (0 à 5)
#define Set_Adr_X       0x80    //Adresse X dans 7 bits LSB (0 à 83)
// Commandes étendues (bit H="1")
#define Set_Bias        0x10    //Bias Mode dans bits 2 à 0
#define Set_Vop         0x80    //Vop dans bits 6 à 0
#define Set_TC          0x04    //Coef de température dans bits 1 à 0
// Positions des paramètres sur le LCD
#define Pos_FRX_X       5       //Position X de la fréquence de réception (0 à 83)
#define Pos_FRX_Y       2       //Position Y de la fréquence de réception (0 à 5)
#define Pos_Filtre_X    41      //Position X de la fréquence de réception (0 à 83)
#define Pos_Filtre_Y    4       //Position Y de la fréquence de réception (0 à 5)

/*------------------------------------------------------------------------------------
                                    Variables globales
-------------------------------------------------------------------------------------*/
/*-----------------
        LCD
-------------------*/
char Adr_X ;// Copie logicielle de l'adresse X du PCD8544 (0 à 83)
char Adr_Y ;// Copie logicielle de l'adresse Y du PCD8544 (0 à 5)

/*------------------------------------------------------------------------------------
                                 Constantes en mémoire flash
-------------------------------------------------------------------------------------*/
/* ---------------------
   Polices de caractères
   ---------------------
Générateur de caractère en mémoire flash
Code Ascii, format 5x7 pixels.
Format : Y    X   1   2   3   4   5
         1       D10 D20 D30 D40 D50
         2       D11 D21 D31 D41 D51
         3       D12 D22 D32 D42 D52
         4       D13 D23 D33 D43 D53
         5       D14 D24 D34 D44 D54
         6       D15 D25 D35 D45 D55
         7       D16 D26 D36 D46 D56
1° octet : D16-D15-D14-D13-D12-D11-D10, bit 7 toujours à "0"
2° octet : D26-D25-D24-D23-D22-D21-D20, bit 7 toujours à "0"
3° octet : D36-D35-D34-D33-D32-D31-D30, bit 7 toujours à "0"
4° octet : D46-D45-D44-D43-D42-D41-D40, bit 7 toujours à "0"
5° octet : D56-D55-D54-D53-D52-D51-D50, bit 7 toujours à "0"
--------------------------------------------------------------------------------------*/
char const FontLookup[94][5] =
{
    { 0x00, 0x00, 0x00, 0x00, 0x00 },   // sp
    { 0x00, 0x00, 0x2f, 0x00, 0x00 },   // !
    { 0x00, 0x07, 0x00, 0x07, 0x00 },   // "
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    { 0x44, 0x64, 0x54, 0x4C, 0x44 },   // z
//                    ----------------
	{ 0x38, 0x56, 0x56, 0x55, 0x19 },   // "�" � utiliser {
	{ 0x38, 0x55, 0x55, 0x56, 0x1A },   // "�" � utiliser | 
	{ 0x20, 0x55, 0x55, 0x56, 0x7A }    // "�" � utiliser } 
};

/*--------------------------------------
Générateur de caractères : chiffres 0 à 9
Nombre de caractères : 10
Résolution X : 10
Résolution Y : 14 */
const char MyFontTab[22][10] =
{
    { 252, 254,   3,   3,   3,   3,   3,   3, 254, 252  }, // 0 octet LSB
    {   0,  16,  24,  12,   6, 255, 255,   0,   0,   0  }, // 1 octet LSB
    {   2,   3, 131, 131, 131, 131, 131, 195, 254, 124  }, // 2 octet LSB
    {   2,   3,   3, 195, 195, 195, 195, 199, 254,  60  }, // 3 octet LSB
    { 192, 224,  48,  24,  12, 198, 195,   1,   0,   0  }, // 4 octet LSB
    {  31,  63,  99,  99,  99,  99,  99,  99, 195, 131  }, // 5 octet LSB
    { 252, 254, 195, 195, 195, 195, 195, 195, 131,   0  }, // 6 octet LSB
    {   2,   3,   3,   3, 131, 195,  99,  51,  31,  15  }, // 7 octet LSB
    { 124, 254, 195, 195, 195, 195, 195, 195, 254,  60  }, // 8 octet LSB
    { 124, 254, 195, 195, 195, 195, 195, 195, 254, 252  }, // 9 octet LSB
    {  15,  31,  48,  48,  48,  48,  48,  48,  31,  15  }, // 0 octet MSB
    {   0,   0,   0,  48,  48,  63,  63,  48,  48,   0  }, // 1 octet MSB
    {  62,  63,  51,  49,  49,  49,  49,  49,  48,  48  }, // 2 octet MSB
    {  16,  48,  48,  48,  48,  48,  48,  56,  31,  15  }, // 3 octet MSB
    {   3,   3,   3,   3,   3,  63,  63,   3,   3,   3  }, // 4 octet MSB
    {  16,  48,  48,  48,  48,  48,  48,  48,  31,  15  }, // 5 octet MSB
    {  15,  31,  48,  48,  48,  48,  48,  48,  31,  15  }, // 6 octet MSB
    {  56,  60,   6,   3,   1,   0,   0,   0,   0,   0  }, // 7 octet MSB
    {  15,  31,  48,  48,  48,  48,  48,  48,  31,  15  }, // 8 octet MSB
    {   0,  48,  48,  48,  48,  48,  48,  48,  31,  15  }  // 9 octet MSB
};

/*--------------------------------------
          Image d'accueil
  --------------------------------------*/
const char Image_Accueil[506] =
{
   0,   0,   0,   0,   0,   0,   0,   0,   0,   0,   0,   0,
   0,   0,   0,   0,   0,   0,   0,   0,   0,   0,   0,   0,
   0,   0,   0,   0,   0,   0,   0,   0,   0,   0,   0,   0,
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   0,   0,   0,   0,   0,   0,   0,   0,   0,   0,   0,   0,
};

//_________________________________________________________________
const char Image_Accueil1[506] =
{
     0,   0,   0,   0,   0,   0,   0,   0,   0,   0,   0,   0,
   0,   0,   0,   0,   0,   0,   0,   0,   0,   0,   0,   0,
   0,   0,   0,   0,   0,   0,   0,   0,   0,   0,   0,   0,
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   0,   0,   0,   0,   0,   0,   0,   0,   0,   0,   0,   0,

};

//_________________________________________________________________
const char Image_Accueil2[506] =
{
   0,   0,   0,   0,   0,   0,   0,   0,   0,   0,   0,   0,
   0,   0,   0,   0,   0,   0,   0,   0,   0,   0,   0,   0,
   0,   0,   0,   0,   0,   0,   0,   0,   0,   0,   0,   0,
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   0,   0,   0,   0,   0,   0,   0,   0,   0,   0,   0,   0,

};
//_________________________________________________________________
const char Image_Accueil3[506] =
{
   0,   0,   0,   0,   0,   0,   0,   0,   0,   0,   0,   0,
   0,   0,   0,   0,   0,   0,   0,   0,   0,   0,   0,   0,
   0,   0,   0,   0,   0,   0,   0,   0,   0,   0,   0,   0,
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   0,   0,   0,   0,   0,   0,   0,   0,   0,   0,   0,   0,


};
//_________________________________________________________________
const char Image_Accueil4[506] =
{
   0,   0,   0,   0,   0,   0,   0,   0,   0,   0,   0,   0,
   0,   0,   0,   0,   0,   0,   0,   0,   0,   0,   0,   0,
   0,   0,   0,   0,   0,   0,   0,   0,   0,   0,   0,   0,
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   7,   7,   7,   7,   7,   7,   7,   7,   7,   7,   7,   7,


};
/*------------------------------------------------------------------------------------
                                   Fonctions de gestion du LCD
--------------------------------------------------------------------------------------*/


/*---------------------------------------------------------------
  Nom          :  LcdSend
  Description  :  Envoi d'un octet vers le controleur du LCD
  Arguments    :  data -> Donnée ou commande à transmettre
                  cd   -> Type de transfert : commande (Lcd_Cmd) ou donnée (Lcd_Data)
  Valeur renvoyée : aucune.
-----------------------------------------------------------------*/
void LcdSend(char Data, LcdCmdData CD)
{
  int i;
  if (CD == Lcd_Data) output_high(Lcd_DC_Pin);
                 else output_low(Lcd_DC_Pin);
  // Transmission série de l'octet
  for (i=0; i<8; i++)
  {
   if ((Data & 0x80)==0) output_low(Lcd_DIN_Pin);
                    else output_high(Lcd_DIN_Pin);
  Data <<= 1;
   output_high(Lcd_CLK_Pin);
   output_low(Lcd_CLK_Pin);
  }
}


/*---------------------------------------------------------------
  Nom          :  LcdInit
  Description  :  Initialisation du PCD8544
  Arguments    :  aucun
  Valeur renvoyée : aucune.
-----------------------------------------------------------------*/
// Note : la commande de contraste est sans effet
void LcdInit(void)
{
  output_high(Lcd_CE_Pin) ; // Controleur non sélectionné (CE = "1")
  output_high(Lcd_RST_Pin); // et pas de reset (RST = "1")
  delay_ms(1);
  output_low(Lcd_RST_Pin); //Reset PCD8544 (RST = "0")
  delay_ms(1);
  output_high(Lcd_RST_Pin); //Arrêt reset PCD8544 (RST = "1")
  Adr_X=0; Adr_Y=0;
  // Sélection du controleur (actif à "0").
  output_low(Lcd_CE_Pin); // CE = "0"
  LcdSend(0x21, Lcd_Cmd); //Mode commandes étendues
  LcdSend(0xBF,Lcd_Cmd); //Set LCD Vop (contrast)
  LcdSend(0x04,Lcd_Cmd);   //Set temp. coefficient
  LcdSend(0x14,Lcd_Cmd);    //LCD Bias mode 1:48
  LcdSend(0x20,Lcd_Cmd); //LCD standard commands. Horizontal addressing mode.
  LcdSend(0x0C,Lcd_Cmd);  //LCD in normal mode (DE = 10)
}

/*---------------------------------------------------------------
  Nom          :  LcdGotoXY
  Description  :  Affecter les adresses X et Y du PCD8544
  Arguments    :  X : position H (0 à 83)
                  Y : position V (0 à 5)
  Valeur renvoyée : aucune.
-----------------------------------------------------------------*/
void LcdGotoXY(char x, char y)
{
  Adr_X=x; Adr_Y=y;
  LcdSend(Set_Adr_X+Adr_X,Lcd_Cmd); //Affectation adresse X
  LcdSend(Set_Adr_Y+Adr_Y,Lcd_Cmd); //Affectation adresse Y
}

/*---------------------------------------------------------------
  Nom          :  Fill_Lcd
  Description  :  Remplir le LCD de la même couleur
  Arguments    :  Coul_Lcd : Noir ou Blanc
  Valeur renvoyée : aucune.
-----------------------------------------------------------------*/
void Fill_Lcd(Couleur Coul_Lcd)
{
 int x,y;
 char b;
 if (Coul_Lcd==Noir) b=255;
                else b=0;
 for (y=0; y<Lcd_Y_res/8+1; y++)
  {
   LcdGotoXY(0,y);
   for (x=0; x<Lcd_X_res; x++) LcdSend(b,Lcd_Data);
  }
 LcdGotoXY(0,0);
}

/*---------------------------------------------------------------
  Nom          :  LcdChar
  Description  :  Dessin d'un caractère à la position actuelle des compteurs X et Y
  Arguments    :  Code Ascii du caractère
  Valeur renvoyée : aucune.
-----------------------------------------------------------------*/
void LcdChar(char c)
{
 int i;
 if (c < ' ') c=c+'a';
 if (c >= 0x80) c=c-0x80+'A';
 for (i=0; i<5; i++) LcdSend(FontLookup[c-32][i],Lcd_Data);
 Adr_X += 5;
}

/*---------------------------------------------------------------
  Nom          :  LcdString
  Description  :  Dessin d'une phrase à la position actuelle des compteurs X et Y
  Arguments    :  Pointeur de la chaîne de caractères
  Valeur renvoyée : aucune.
-----------------------------------------------------------------*/
void LcdString(char X, char Y, char *Phrase)
{
 LcdGotoXY(X,Y);
 while (*Phrase)
  {
   LcdChar(*Phrase++);
   LcdSend(0,Lcd_Data); // Espace inter-caractères
   Adr_X++;
   if (Adr_X > Lcd_X_res-5)
    {
     LcdGotoXY(0,Y+1);
    }
  }
}

/*---------------------------------------------------------------
  Nom          :  LcdBigDigit
  Description  :  Dessin d'un chiffre 14x10 pixels à la position actuelle des
                  compteurs X et Y
  Arguments    :  Chiffre codé BCD
  Valeur renvoyée : aucune.
-----------------------------------------------------------------*/
void LcdBigDigit(char b)
{
 int i;
 for (i=0; i<10; i++) LcdSend(MyFontTab[b][i],Lcd_Data); // D'abord les octets LSB
 LcdSend(Set_Adr_X+Adr_X,Lcd_Cmd);   // Retour au début du dessin
 LcdSend(Set_Adr_Y+Adr_Y+1,Lcd_Cmd); // Octets MSB à la ligne de 8 pixels inférieure
 for (i=0; i<10; i++) LcdSend(MyFontTab[b+10][i],Lcd_Data); // Puis les octets MSB
 Adr_X += 12;
 LcdSend(Set_Adr_Y+Adr_Y,Lcd_Cmd); //Prochain chiffre sur la même ligne
 LcdSend(Set_Adr_X+Adr_X,Lcd_Cmd); //et 12 pixels à droite
}

/*---------------------------------------------------------------
  Nom          :  LcdBigString
  Description  :  Dessin d'une suite de chiffres à la position actuelle
                  des compteurs X et Y
  Arguments    :  Pointeur de la chaîne de caractères
  Valeur renvoyée : aucune.
-----------------------------------------------------------------*/
void LcdBigString(char *Chaine)
{
 while (*Chaine) LcdBigDigit(*Chaine++ - '0');
}

/*---------------------------------------------------------------
  Nom          :  ClearLineLcd
  Description  :  Effacer une ligne du LCD
  Arguments    :  X ,Y : position initiale (X:0 à 83 et Y:0 à 5)
                  LngLine : longueur de la ligne en pixels
  Valeur renvoyée : aucune.
-----------------------------------------------------------------*/
void ClearLineLcd(char X, char Y, char LngLine)
{
 int i;
 LcdGotoXY(X,Y);
 for (i=0; i<LngLine; i++) LcdSend(0,Lcd_Data);
}

/*---------------------------------------------------------------
  Nom          :  ImageLcd
  Description  :  Afficher une image sur le LCD
  Arguments    :  Aucun
  Valeur renvoyée : Aucune.
-----------------------------------------------------------------*/
void ImageLcd(void)
{
 int16 x,y;
 for (y=0; y<Lcd_Y_res/8+1; y++)
  {
   LcdGotoXY(0,y);
   for (x=0; x<Lcd_X_res; x++) 
	{
	LcdSend(Image_Accueil[x+y*Lcd_X_res],Lcd_Data);
	}
  }
 LcdGotoXY(0,0);
}
//______________________________________________________________
void ImageLcd1(void)
{
 int16 x,y;
 for (y=0; y<Lcd_Y_res/8+1; y++)
  {
   LcdGotoXY(0,y);
   for (x=0; x<Lcd_X_res; x++) 
	{	
	LcdSend(Image_Accueil1[x+y*Lcd_X_res],Lcd_Data);
	}
  }
 LcdGotoXY(0,0);
}
//______________________________________________________________
void ImageLcd2(void)
{
 int16 x,y;
 for (y=0; y<Lcd_Y_res/8+1; y++)
  {
   LcdGotoXY(0,y);
   for (x=0; x<Lcd_X_res; x++) 
	{	
	LcdSend(Image_Accueil2[x+y*Lcd_X_res],Lcd_Data);
	}
  }
 LcdGotoXY(0,0);
}
//______________________________________________________________
void ImageLcd3(void)
{
 int16 x,y;
 for (y=0; y<Lcd_Y_res/8+1; y++)
  {
   LcdGotoXY(0,y);
   for (x=0; x<Lcd_X_res; x++) 
	{	
	LcdSend(Image_Accueil3[x+y*Lcd_X_res],Lcd_Data);
	}
  }
 LcdGotoXY(0,0);
}
//______________________________________________________________
void ImageLcd4(void)
{
 int16 x,y;
 for (y=0; y<Lcd_Y_res/8+1; y++)
  {
   LcdGotoXY(0,y);
   for (x=0; x<Lcd_X_res; x++) 
	{	
	LcdSend(Image_Accueil4[x+y*Lcd_X_res],Lcd_Data);
	}
  }
 LcdGotoXY(0,0);
}